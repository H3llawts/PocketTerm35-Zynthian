/dts-v1/;
/plugin/;

/ {
    compatible = "brcm,bcm2708";

    fragment@0 {
        target = <&i2c1>;
        __overlay__ {
            #address-cells = <1>;
            #size-cells = <0>;
            touchscreen@5d {
                compatible = "goodix,gt911";
                reg = <0x5d>;
                interrupt-parent = <&gpio>;
                interrupts = <4 2>;
                touchscreen-size-x = <640>;
                touchscreen-size-y = <480>;
                touchscreen-x-mm = <70>;
                touchscreen-y-mm = <53>;
            };
        };
    };
};
